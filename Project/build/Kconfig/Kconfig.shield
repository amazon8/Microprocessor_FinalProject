## Project/build/Kconfig/Kconfig.shield
```kconfig
osource "c:/ncs/myapps/led_ws2812/boards/shields/*/Kconfig.shield"
osource "c:/ncs/myapps/project/boards/shields/*/Kconfig.shield"
osource "C:/ncs/v2.5.0/nrf/boards/shields/*/Kconfig.shield"
```

## Project/build/Kconfig/Kconfig.shield.defconfig
```kconfig
osource "c:/ncs/myapps/led_ws2812/boards/shields/*/Kconfig.defconfig"
osource "c:/ncs/myapps/project/boards/shields/*/Kconfig.defconfig"
osource "C:/ncs/v2.5.0/nrf/boards/shields/*/Kconfig.defconfig"
```

## battey_led/build/Kconfig/Kconfig.shield.defconfig
```kconfig
osource "/Users/home/Downloads/LEDMatrix_1/boards/shields/*/Kconfig.defconfig"
osource "/Users/home/Desktop/ncs/v2.5.0/zephyr/samples/drivers/led_ws2812/boards/shields/*/Kconfig.defconfig"
osource "/Users/home/Downloads/led_ws2812_original/boards/shields/*/Kconfig.defconfig"
osource "/Users/home/Downloads/timer/boards/shields/*/Kconfig.defconfig"
osource "/Users/home/Downloads/encoder/boards/shields/*/Kconfig.defconfig"
osource "/Users/home/Downloads/intergrate_led_encdoder/boards/shields/*/Kconfig.defconfig"
osource "/Users/home/Downloads/rgb_led/boards/shields/*/Kconfig.defconfig"
osource "/Users/home/Desktop/ncs/v2.5.0/nrf/boards/shields/*/Kconfig.defconfig"
```

## build/Kconfig/Kconfig.modules
```kconfig
menu "nrf (/Users/home/Desktop/ncs/v2.5.0/nrf)"
osource "/Users/home/Desktop/ncs/v2.5.0/nrf/Kconfig.nrf"
config ZEPHYR_NRF_MODULE
	bool
	default y
endmenu
menu "wfa-qt-control-app (/Users/home/Desktop/ncs/v2.5.0/modules/lib/wfa-qt-control-app)"
osource "/Users/home/Desktop/ncs/v2.5.0/modules/lib/wfa-qt-control-app/zephyr/Kconfig"
config ZEPHYR_WFA_QT_CONTROL_APP_MODULE
	bool
	default y
endmenu
menu "mcuboot (/Users/home/Desktop/ncs/v2.5.0/bootloader/mcuboot)"
osource "$(ZEPHYR_MCUBOOT_KCONFIG)"
config ZEPHYR_MCUBOOT_MODULE
	bool
	default y
endmenu
menu "mbedtls (/Users/home/Desktop/ncs/v2.5.0/modules/crypto/mbedtls)"
osource "$(ZEPHYR_MBEDTLS_KCONFIG)"
config ZEPHYR_MBEDTLS_MODULE
	bool
	default y
endmenu
menu "trusted-firmware-m (/Users/home/Desktop/ncs/v2.5.0/modules/tee/tf-m/trusted-firmware-m)"
osource "$(ZEPHYR_TRUSTED_FIRMWARE_M_KCONFIG)"
config ZEPHYR_TRUSTED_FIRMWARE_M_MODULE
	bool
	default y
endmenu
menu "cjson (/Users/home/Desktop/ncs/v2.5.0/modules/lib/cjson)"
osource "$(ZEPHYR_CJSON_KCONFIG)"
config ZEPHYR_CJSON_MODULE
	bool
	default y
endmenu
menu "azure-sdk-for-c (/Users/home/Desktop/ncs/v2.5.0/modules/lib/azure-sdk-for-c)"
osource "$(ZEPHYR_AZURE_SDK_FOR_C_KCONFIG)"
config ZEPHYR_AZURE_SDK_FOR_C_MODULE
	bool
	default y
endmenu
menu "cirrus-logic (/Users/home/Desktop/ncs/v2.5.0/modules/hal/cirrus-logic)"
osource "/Users/home/Desktop/ncs/v2.5.0/modules/hal/cirrus-logic/Kconfig"
config ZEPHYR_CIRRUS_LOGIC_MODULE
	bool
	default y
endmenu
menu "openthread (/Users/home/Desktop/ncs/v2.5.0/modules/lib/openthread)"
osource "$(ZEPHYR_OPENTHREAD_KCONFIG)"
config ZEPHYR_OPENTHREAD_MODULE
	bool
	default y
endmenu
menu "memfault-firmware-sdk (/Users/home/Desktop/ncs/v2.5.0/modules/lib/memfault-firmware-sdk)"
osource "/Users/home/Desktop/ncs/v2.5.0/modules/lib/memfault-firmware-sdk/ports/zephyr/Kconfig"
config ZEPHYR_MEMFAULT_FIRMWARE_SDK_MODULE
	bool
	default y
endmenu
menu "canopennode (/Users/home/Desktop/ncs/v2.5.0/modules/lib/canopennode)"
osource "$(ZEPHYR_CANOPENNODE_KCONFIG)"
config ZEPHYR_CANOPENNODE_MODULE
	bool
	default y
endmenu
menu "chre (/Users/home/Desktop/ncs/v2.5.0/modules/lib/chre)"
osource "/Users/home/Desktop/ncs/v2.5.0/modules/lib/chre/platform/zephyr/Kconfig"
config ZEPHYR_CHRE_MODULE
	bool
	default y
endmenu
menu "cmsis (/Users/home/Desktop/ncs/v2.5.0/modules/hal/cmsis)"
osource "$(ZEPHYR_CMSIS_KCONFIG)"
config ZEPHYR_CMSIS_MODULE
	bool
	default y
endmenu
menu "fatfs (/Users/home/Desktop/ncs/v2.5.0/modules/fs/fatfs)"
osource "$(ZEPHYR_FATFS_KCONFIG)"
config ZEPHYR_FATFS_MODULE
	bool
	default y
endmenu
menu "hal_nordic (/Users/home/Desktop/ncs/v2.5.0/modules/hal/nordic)"
osource "$(ZEPHYR_HAL_NORDIC_KCONFIG)"
config ZEPHYR_HAL_NORDIC_MODULE
	bool
	default y
endmenu
menu "liblc3 (/Users/home/Desktop/ncs/v2.5.0/modules/lib/liblc3)"
osource "$(ZEPHYR_LIBLC3_KCONFIG)"
config ZEPHYR_LIBLC3_MODULE
	bool
	default y
endmenu
menu "littlefs (/Users/home/Desktop/ncs/v2.5.0/modules/fs/littlefs)"
osource "$(ZEPHYR_LITTLEFS_KCONFIG)"
config ZEPHYR_LITTLEFS_MODULE
	bool
	default y
endmenu
menu "loramac-node (/Users/home/Desktop/ncs/v2.5.0/modules/lib/loramac-node)"
osource "$(ZEPHYR_LORAMAC_NODE_KCONFIG)"
config ZEPHYR_LORAMAC_NODE_MODULE
	bool
	default y
endmenu
menu "lvgl (/Users/home/Desktop/ncs/v2.5.0/modules/lib/gui/lvgl)"
osource "/Users/home/Desktop/ncs/v2.5.0/modules/lib/gui/lvgl/Kconfig"
config ZEPHYR_LVGL_MODULE
	bool
	default y
endmenu
menu "lz4 (/Users/home/Desktop/ncs/v2.5.0/modules/lib/lz4)"
osource "$(ZEPHYR_LZ4_KCONFIG)"
config ZEPHYR_LZ4_MODULE
	bool
	default y
endmenu
menu "nanopb (/Users/home/Desktop/ncs/v2.5.0/modules/lib/nanopb)"
osource "$(ZEPHYR_NANOPB_KCONFIG)"
config ZEPHYR_NANOPB_MODULE
	bool
	default y
endmenu
menu "picolibc (/Users/home/Desktop/ncs/v2.5.0/modules/lib/picolibc)"
osource "/Users/home/Desktop/ncs/v2.5.0/modules/lib/picolibc/zephyr/Kconfig"
config ZEPHYR_PICOLIBC_MODULE
	bool
	default y
endmenu
menu "segger (/Users/home/Desktop/ncs/v2.5.0/modules/debug/segger)"
osource "$(ZEPHYR_SEGGER_KCONFIG)"
config ZEPHYR_SEGGER_MODULE
	bool
	default y
endmenu
menu "TraceRecorder (/Users/home/Desktop/ncs/v2.5.0/modules/debug/TraceRecorder)"
osource "/Users/home/Desktop/ncs/v2.5.0/modules/debug/TraceRecorder/kernelports/Zephyr/Kconfig"
config ZEPHYR_TRACERECORDER_MODULE
	bool
	default y
endmenu
menu "uoscore-uedhoc (/Users/home/Desktop/ncs/v2.5.0/modules/lib/uoscore-uedhoc)"
osource "$(ZEPHYR_UOSCORE_UEDHOC_KCONFIG)"
config ZEPHYR_UOSCORE_UEDHOC_MODULE
	bool
	default y
endmenu
menu "zcbor (/Users/home/Desktop/ncs/v2.5.0/modules/lib/zcbor)"
osource "$(ZEPHYR_ZCBOR_KCONFIG)"
config ZEPHYR_ZCBOR_MODULE
	bool
	default y
endmenu
menu "zscilib (/Users/home/Desktop/ncs/v2.5.0/modules/lib/zscilib)"
osource "/Users/home/Desktop/ncs/v2.5.0/modules/lib/zscilib/Kconfig.zscilib"
config ZEPHYR_ZSCILIB_MODULE
	bool
	default y
endmenu
menu "nrfxlib (/Users/home/Desktop/ncs/v2.5.0/nrfxlib)"
osource "/Users/home/Desktop/ncs/v2.5.0/nrfxlib/Kconfig.nrfxlib"
config ZEPHYR_NRFXLIB_MODULE
	bool
	default y
endmenu
menu "connectedhomeip (/Users/home/Desktop/ncs/v2.5.0/modules/lib/matter)"
osource "/Users/home/Desktop/ncs/v2.5.0/modules/lib/matter/config/nrfconnect/chip-module/Kconfig"
config ZEPHYR_CONNECTEDHOMEIP_MODULE
	bool
	default y
endmenu
```

## build/Kconfig/Kconfig.sysbuild.modules
```kconfig
menu "nrf (/Users/home/Desktop/ncs/v2.5.0/nrf)"
osource "/Users/home/Desktop/ncs/v2.5.0/nrf/sysbuild/Kconfig.sysbuild"
config ZEPHYR_NRF_MODULE
	bool
	default y
endmenu
```

## intergrate_led_encdoder/build/Kconfig/Kconfig.modules
```kconfig
menu "acpica (C:/ncs/modules/lib/acpica)"
osource "$(ZEPHYR_ACPICA_KCONFIG)"
config ZEPHYR_ACPICA_MODULE
	bool
	default y
endmenu
menu "cmsis (C:/ncs/modules/hal/cmsis)"
osource "$(ZEPHYR_CMSIS_KCONFIG)"
config ZEPHYR_CMSIS_MODULE
	bool
	default y
endmenu
menu "cmsis-dsp (C:/ncs/modules/lib/cmsis-dsp)"
osource "$(ZEPHYR_CMSIS_DSP_KCONFIG)"
config ZEPHYR_CMSIS_DSP_MODULE
	bool
	default y
endmenu
menu "cmsis-nn (C:/ncs/modules/lib/cmsis-nn)"
osource "$(ZEPHYR_CMSIS_NN_KCONFIG)"
config ZEPHYR_CMSIS_NN_MODULE
	bool
	default y
endmenu
menu "fatfs (C:/ncs/modules/fs/fatfs)"
osource "$(ZEPHYR_FATFS_KCONFIG)"
config ZEPHYR_FATFS_MODULE
	bool
	default y
endmenu
config ZEPHYR_ADI_MODULE
   bool
   default y
config ZEPHYR_ALTERA_MODULE
   bool
   default y
menu "hal_ambiq (C:/ncs/modules/hal/ambiq)"
osource "$(ZEPHYR_HAL_AMBIQ_KCONFIG)"
config ZEPHYR_HAL_AMBIQ_MODULE
	bool
	default y
endmenu
config ZEPHYR_ATMEL_MODULE
   bool
   default y
menu "hal_espressif (C:/ncs/modules/hal/espressif)"
osource "C:/ncs/modules/hal/espressif/zephyr/Kconfig"
config ZEPHYR_HAL_ESPRESSIF_MODULE
	bool
	default y
endmenu
menu "hal_ethos_u (C:/ncs/modules/hal/ethos_u)"
osource "$(ZEPHYR_HAL_ETHOS_U_KCONFIG)"
config ZEPHYR_HAL_ETHOS_U_MODULE
	bool
	default y
endmenu
menu "hal_gigadevice (C:/ncs/modules/hal/gigadevice)"
osource "$(ZEPHYR_HAL_GIGADEVICE_KCONFIG)"
config ZEPHYR_HAL_GIGADEVICE_MODULE
	bool
	default y
endmenu
menu "hal_infineon (C:/ncs/modules/hal/infineon)"
osource "$(ZEPHYR_HAL_INFINEON_KCONFIG)"
config ZEPHYR_HAL_INFINEON_MODULE
	bool
	default y
endmenu
config ZEPHYR_HAL_INTEL_MODULE
   bool
   default y
config ZEPHYR_MICROCHIP_MODULE
   bool
   default y
menu "hal_nordic (C:/ncs/modules/hal/nordic)"
osource "$(ZEPHYR_HAL_NORDIC_KCONFIG)"
config ZEPHYR_HAL_NORDIC_MODULE
	bool
	default y
endmenu
config ZEPHYR_NUVOTON_MODULE
   bool
   default y
menu "hal_nxp (C:/ncs/modules/hal/nxp)"
osource "$(ZEPHYR_HAL_NXP_KCONFIG)"
config ZEPHYR_HAL_NXP_MODULE
	bool
	default y
endmenu
config ZEPHYR_OPENISA_MODULE
   bool
   default y
config ZEPHYR_QUICKLOGIC_MODULE
   bool
   default y
config ZEPHYR_HAL_RENESAS_MODULE
   bool
   default y
menu "hal_rpi_pico (C:/ncs/modules/hal/rpi_pico)"
osource "$(ZEPHYR_HAL_RPI_PICO_KCONFIG)"
config ZEPHYR_HAL_RPI_PICO_MODULE
	bool
	default y
endmenu
menu "silabs (C:/ncs/modules/hal/silabs)"
osource "C:/ncs/modules/hal/silabs/zephyr/Kconfig"
config ZEPHYR_SILABS_MODULE
	bool
	default y
endmenu
menu "hal_st (C:/ncs/modules/hal/st)"
osource "$(ZEPHYR_HAL_ST_KCONFIG)"
config ZEPHYR_HAL_ST_MODULE
	bool
	default y
endmenu
config ZEPHYR_STM32_MODULE
   bool
   default y
menu "hal_telink (C:/ncs/modules/hal/telink)"
osource "C:/ncs/modules/hal/telink/Kconfig"
config ZEPHYR_HAL_TELINK_MODULE
	bool
	default y
endmenu
config ZEPHYR_TI_MODULE
   bool
   default y
config ZEPHYR_HAL_WURTHELEKTRONIK_MODULE
   bool
   default y
config ZEPHYR_XTENSA_MODULE
   bool
   default y
menu "hostap (C:/ncs/modules/lib/hostap)"
osource "$(ZEPHYR_HOSTAP_KCONFIG)"
config ZEPHYR_HOSTAP_MODULE
	bool
	default y
endmenu
config ZEPHYR_LIBMETAL_MODULE
   bool
   default y
menu "liblc3 (C:/ncs/modules/lib/liblc3)"
osource "$(ZEPHYR_LIBLC3_KCONFIG)"
config ZEPHYR_LIBLC3_MODULE
	bool
	default y
endmenu
menu "littlefs (C:/ncs/modules/fs/littlefs)"
osource "$(ZEPHYR_LITTLEFS_KCONFIG)"
config ZEPHYR_LITTLEFS_MODULE
	bool
	default y
endmenu
menu "loramac-node (C:/ncs/modules/lib/loramac-node)"
osource "$(ZEPHYR_LORAMAC_NODE_KCONFIG)"
config ZEPHYR_LORAMAC_NODE_MODULE
	bool
	default y
endmenu
menu "lvgl (C:/ncs/modules/lib/gui/lvgl)"
osource "C:/ncs/modules/lib/gui/lvgl/Kconfig"
config ZEPHYR_LVGL_MODULE
	bool
	default y
endmenu
menu "mbedtls (C:/ncs/modules/crypto/mbedtls)"
osource "$(ZEPHYR_MBEDTLS_KCONFIG)"
config ZEPHYR_MBEDTLS_MODULE
	bool
	default y
endmenu
config ZEPHYR_MIPI_SYS_T_MODULE
   bool
   default y
config ZEPHYR_NRF_HW_MODELS_MODULE
   bool
   default y
config ZEPHYR_OPEN_AMP_MODULE
   bool
   default y
menu "openthread (C:/ncs/modules/lib/openthread)"
osource "$(ZEPHYR_OPENTHREAD_KCONFIG)"
config ZEPHYR_OPENTHREAD_MODULE
	bool
	default y
endmenu
menu "percepio (C:/ncs/modules/debug/percepio)"
osource "C:/ncs/modules/debug/percepio/zephyr/Kconfig"
config ZEPHYR_PERCEPIO_MODULE
	bool
	default y
endmenu
menu "picolibc (C:/ncs/modules/lib/picolibc)"
osource "C:/ncs/modules/lib/picolibc/zephyr/Kconfig"
config ZEPHYR_PICOLIBC_MODULE
	bool
	default y
endmenu
menu "segger (C:/ncs/modules/debug/segger)"
osource "$(ZEPHYR_SEGGER_KCONFIG)"
config ZEPHYR_SEGGER_MODULE
	bool
	default y
endmenu
config ZEPHYR_TINYCRYPT_MODULE
   bool
   default y
menu "trusted-firmware-m (C:/ncs/modules/tee/tf-m/trusted-firmware-m)"
osource "$(ZEPHYR_TRUSTED_FIRMWARE_M_KCONFIG)"
config ZEPHYR_TRUSTED_FIRMWARE_M_MODULE
	bool
	default y
endmenu
menu "trusted-firmware-a (C:/ncs/modules/tee/tf-a/trusted-firmware-a)"
osource "$(ZEPHYR_TRUSTED_FIRMWARE_A_KCONFIG)"
config ZEPHYR_TRUSTED_FIRMWARE_A_MODULE
	bool
	default y
endmenu
menu "uoscore-uedhoc (C:/ncs/modules/lib/uoscore-uedhoc)"
osource "$(ZEPHYR_UOSCORE_UEDHOC_KCONFIG)"
config ZEPHYR_UOSCORE_UEDHOC_MODULE
	bool
	default y
endmenu
menu "zcbor (C:/ncs/modules/lib/zcbor)"
osource "$(ZEPHYR_ZCBOR_KCONFIG)"
config ZEPHYR_ZCBOR_MODULE
	bool
	default y
endmenu
```

## intergrate_led_encdoder/build/Kconfig/Kconfig.shield
```kconfig
osource "/Users/home/Downloads/LEDMatrix_1/boards/shields/*/Kconfig.shield"
osource "/Users/home/Desktop/ncs/v2.5.0/zephyr/samples/drivers/led_ws2812/boards/shields/*/Kconfig.shield"
osource "/Users/home/Downloads/led_ws2812_original/boards/shields/*/Kconfig.shield"
osource "/Users/home/Downloads/timer/boards/shields/*/Kconfig.shield"
osource "/Users/home/Downloads/encoder/boards/shields/*/Kconfig.shield"
osource "/Users/home/Downloads/intergrate_led_encdoder/boards/shields/*/Kconfig.shield"
osource "/Users/home/Desktop/ncs/v2.5.0/nrf/boards/shields/*/Kconfig.shield"
```
