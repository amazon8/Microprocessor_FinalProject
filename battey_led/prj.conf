## CMakeLists.txt
```
cmake_minimum_required(VERSION 3.20.0)
find_package(Zephyr REQUIRED HINTS $ENV{ZEPHYR_BASE})

project(secondscounter_example2)

FILE(GLOB app_sources src/*.c)
target_sources(app PRIVATE ${app_sources})
```

## prj.conf
```kconfig
CONFIG_PRINTK=y
CONFIG_LOG=y
CONFIG_I2C=y
CONFIG_LED=y
CONFIG_KSCAN=y
CONFIG_KSCAN_INIT_PRIORITY=95
CONFIG_HT16K33_KEYSCAN=y
CONFIG_GPIO=y
```

## boards/mimxrt1050_evk.conf
```kconfig
CONFIG_WS2812_STRIP_SPI=y
CONFIG_SPI=y
```

## boards/nucleo_f070rb.conf
```kconfig
CONFIG_SPI=y
CONFIG_SPI_STM32_DMA=y
```

## boards/thingy52_nrf52832.conf
```kconfig
CONFIG_SPI=n

CONFIG_I2S=y
CONFIG_WS2812_STRIP=y
CONFIG_WS2812_STRIP_I2S=y
```

## boards/nrf51dk_nrf51422.overlay
```dts
/*
 * Copyright (c) 2019, Nordic Semiconductor ASA
 *
 * SPDX-License-Identifier: Apache-2.0
 */

#include <zephyr/dt-bindings/gpio/gpio.h>
#include <zephyr/dt-bindings/led/led.h>

/ {
	led_strip: ws2812 {
		compatible = "worldsemi,ws2812-gpio";

		chain-length = <16>; /* arbitrary */
		color-mapping = <LED_COLOR_ID_GREEN
				 LED_COLOR_ID_RED
				 LED_COLOR_ID_BLUE>;
		/*
		 * Arduino D11 / P0.25, which was chosen to match the pin
		 * used in nrf52dk_nrf52832.overlay.
		 */
		in-gpios = <&gpio0 25 0>;
	};

	aliases {
		led-strip = &led_strip;
	};
};
```

## src/main.c
```c
#include <zephyr/kernel.h>
#include <zephyr/device.h>
#include <zephyr/devicetree.h>
#include <zephyr/sys/util.h>

#include "led.h"
#include "batterydisplay.h"
#include "value.h"

struct k_timer my_timer;
struct k_work my_work;

static int seconds = 0;

void my_work_handler(struct k_work *work)
{
        printk("Time: %d\n", seconds);

        // Display the time on the LED matrix
        led_on_seconds(seconds);

        // // Display the time on the battery display
        // if( seconds == 0){
        //         display_level(0);
        // } else if(seconds > 0 && seconds < 10){
        //         display_level(1); // 빨간
        // } else if(seconds >= 10 && seconds < 20){
        //         display_level(2);
        // } else if(seconds >= 20 && seconds < 30){
        //         display_level(3); 
        // } else if(seconds >= 30 && seconds < 40){
        //         display_level(4); // 주황
        // } else if(seconds >= 40 && seconds < 50){
        //         display_level(5); 
        // } else if(seconds >= 50 && seconds < 56){
        //         display_level(6); // 초록
        // } else {
        //         display_level(7); // 파랑
        // }

        // Display the time on the battery display
        if( seconds == 0){
                display_level(0);
        } else if(seconds > 0 && seconds <= 15){
                display_level(1); // 빨간
        } else if(seconds > 15 && seconds <= 30){
                display_level(4); // 주황
        } else if(seconds > 30 && seconds <= 45){
                display_level(6); // 초록
        } else {
                display_level(7); // 파랑
        }        


        // Increment the seconds
        seconds = seconds + 15;
        if(seconds > 60){
                seconds = 0;
        }
}

K_WORK_DEFINE(my_work, my_work_handler);

void my_timer_handler(struct k_timer *dummy)
{
        k_work_submit(&my_work);
}

K_TIMER_DEFINE(my_timer, my_timer_handler, NULL);

int main(void)
{
        printk("Seconds counter example 2\n");
        int ret = DK_OK;

        ret = batterydisplay_intit();
        if(ret != DK_OK){
                printk("Error initializing battery display\n");
                return DK_ERR;
        }

        ret = led_init();
        if(ret != DK_OK){
                printk("Error initializing LED\n");
                return DK_ERR;
        }

        // Start the timer
        k_timer_start(&my_timer, K_SECONDS(1), K_SECONDS(1));

        return DK_OK;
}
```

## src/led.h
```c
#include <zephyr/drivers/led.h>
#include <zephyr/drivers/kscan.h>
#include <zephyr/devicetree.h>
#include <zephyr/kernel.h>

#define MAX_LED_MATRIX_IDX 10
#define MAX_LED_NUM 128
#define MAX_LED_MATRIX_NUM 64

#define TENS_START_INDEX 0
#define UNITS_START_INDEX 8

#define LED_NODE DT_COMPAT_GET_ANY_STATUS_OKAY(holtek_ht16k33)
#define KEY_NODE DT_CHILD(LED_NODE, keyscan)

static const struct device *const led = DEVICE_DT_GET(LED_NODE);

int led_init(void);
void led_on_seconds(int seconds);
```
